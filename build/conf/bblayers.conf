## build/conf/bblayers.conf
```bitbake
# LAYER_CONF_VERSION is increased each time build/conf/bblayers.conf
# changes incompatibly
LCONF_VERSION = "4"
WPSS_POKY_ROOTDIR = "/mnt/datadisk0/phase2/wpss-buildenv/poky"

BBFILES ?= ""
BBLAYERS ?= " \
  ${WPSS_POKY_ROOTDIR}/meta \
  ${WPSS_POKY_ROOTDIR}/meta-yocto \
  ${WPSS_POKY_ROOTDIR}/meta-openembedded/meta-oe \
  ${WPSS_POKY_ROOTDIR}/meta-wpss \
  ${WPSS_POKY_ROOTDIR}/meta-gumstix \
  ${WPSS_POKY_ROOTDIR}/meta-ti \
  "
```

## user.collection/conf/machine/overo.conf
```bitbake
#@TYPE: Machine
#@NAME: overo-econ machine
#@DESCRIPTION: Machine configuration for the Gumstix Overo

require conf/machine/include/omap3.inc

TARGET_ARCH = "arm"
#ANGSTROM_BLACKLIST_pn-gnome-games	= "gnome-games SUCKS"

PREFERRED_PROVIDER_virtual/bootloader = "u-boot"
UBOOT_MACHINE = "omap3_overo_config"

PREFERRED_PROVIDER_virtual/kernel = "linux-omap3"
#PREFERRED_PROVIDER_virtual/kernel = "linux-omap3-pap"
#PREFERRED_VERSION_virtual/kernel = "2.6.34"
#PREFERRED_VERSION_linux-omap3-pap="2.6.34"
#PREFERRED_VERSION_ti-linuxutils = "3_22_00_02"

MUSB_MODE = "host"

PREFERRED_PROVIDER_virtual/xserver = "xserver-xorg"
XSERVER = "xserver-xorg \
           xserver-xorg-extension-dri \
           xserver-xorg-extension-glx \
           xf86-input-evdev \
           xf86-input-mouse \
           xf86-input-tslib \
           xf86-video-omapfb \
           xf86-input-keyboard"

GUI_MACHINE_CLASS = "smallscreen"

IMAGE_FSTYPES += "tar.bz2 ubi"

SERIAL_CONSOLE = "115200 ttyS2"

ANGSTROM_URI = "http://cumulus.gumstix.org"

# do ubiattach /dev/ubi_ctrl -m 4
# From dmesg:
# UBI: smallest flash I/O unit:    2048
# UBI: logical eraseblock size:    129024 bytes
# from ubiattach stdout:
# UBI device number 0, total 1996 LEBs
MKUBIFS_ARGS = "-m 2048 -e 129024 -c 1996"

# do ubiattach /dev/ubi_ctrl -m 4
# from dmesg:
# UBI: smallest flash I/O unit:    2048
# UBI: physical eraseblock size:   131072 bytes (128 KiB)
# UBI: sub-page size:              512
UBINIZE_ARGS = "-m 2048 -p 128KiB -s 512"
UBI_VOLNAME = "rootfs"

MACHINE_EXTRA_RRECOMMENDS = " kernel-modules"
MACHINE_EXTRA_RRECOMMENDS += " omap3-sgx-modules"
MACHINE_EXTRA_RRECOMMENDS += " ti-cmem-module ti-dsplink-module ti-lpm-module ti-sdma-module"
MACHINE_FEATURES = "kernel26 alsa apm ext2 screen touchscreen usbgadget usbhost vfat"
```
